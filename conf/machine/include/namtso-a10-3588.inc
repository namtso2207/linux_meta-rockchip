## conf/machine/include/namtso-a10-3588.inc
```bitbake
# Copyright (c) 2023, Wesion Technology Co., Ltd
# Released under the MIT license (see COPYING.MIT for the terms)

SOC_FAMILY ?= "rk3588"
PREFERRED_VERSION_linux-rockchip ?= "5.10%"
LINUXLIBCVERSION ?= "5.10-custom%"

require conf/machine/include/rockchip-arm64-common.inc

KBUILD_DEFCONFIG = "namtso_a10_rk3588_defconfig"

MALI_GPU := "valhall-g610"
MALI_VERSION ?= "g6p0"

RK_ISP_VERSION := "3.0"
```

## conf/machine/namtso-a10-3588.conf
```bitbake
# Copyright (c) 2023, Wesion Technology Co., Ltd
# Released under the MIT license (see COPYING.MIT for the terms)

#@TYPE: Machine
#@NAME: A10-3588

require conf/machine/include/namtso-a10-3588.inc

KERNEL_DEVICETREE = "rockchip/namtso-a10-rk3588.dtb"

UBOOT_MACHINE = "namtso_a10_rk3588"

RK_WIFIBT_FIRMWARES = " \
	rkwifibt-firmware-ap6275p-wifi \
	rkwifibt-firmware-ap6275-bt \
	brcm-tools \
"
```
